&ospi {
	flash@0 {
		compatible = "mt35xu02g", "micron,m25p80", "jedec,spi-nor", "spi-flash";
		reg = <0x0>;
		#address-cells = <1>;
		#size-cells = <1>;
		cdns,read-delay = <0x0>;
		cdns,tshsl-ns = <0x0>;
		cdns,tsd2d-ns = <0x0>;
		cdns,tchsh-ns = <0x1>;
		cdns,tslch-ns = <0x1>;
		spi-tx-bus-width = <0x8>;
		spi-rx-bus-width = <0x8>;
		spi-max-frequency = <20000000>;
		no-wp;
	}; 
};
