## conf/layer.conf
```bitbake
# We have a conf and classes directory, add to BBPATH
BBPATH .= ":${LAYERDIR}"

# We have recipes-* directories, add to BBFILES
BBFILES += "${LAYERDIR}/recipes-*/*/*.bb \
	${LAYERDIR}/recipes-*/*/*.bbappend"

BBFILE_COLLECTIONS += "mango"
BBFILE_PATTERN_mango = "^${LAYERDIR}/"
# prior to meta-user (7)
BBFILE_PRIORITY_mango = "9"

# This layer depends on the Xilinx BSP layer. (device tree)
LAYERDEPENDS_mango = "core xilinx-bsp"

LAYERSERIES_COMPAT_mango = "scarthgap"
```

## conf/machine/mango-versal-lp-generic.conf
```bitbake
#@TYPE: Machine
#@NAME: Mango Versal LP Generic
#@DESCRIPTION: Machine configuration for Mango Versal LP Generic.

# Include common settings.
require conf/machine/mango-common.inc
```

## meta-mango-xilinx/conf/machine/mango-common.inc
```bitbake
#@TYPE: Machine
#@DESCRIPTION: Common configurations for Mango Versal boards

# Include and inherit settings from the versal-generic machine in meta-xilinx.
require conf/machine/versal-generic.conf
```
